## src/modules/app_https_client/Kconfig.app_https_client
```kconfig
#
# Copyright (c) 2026 Nordic Semiconductor ASA
#
# SPDX-License-Identifier: LicenseRef-Nordic-5-Clause
#

config APP_HTTPS_CLIENT_MODULE
	bool "Enable periodic HTTPS client requests"
	help
	  Enable application HTTPS client that sends periodic HEAD requests
	  to a configured hostname.

if APP_HTTPS_CLIENT_MODULE

config APP_HTTPS_HOSTNAME
	string "HTTPS hostname"
	help
	  The hostname to send HTTPS requests to.

config APP_HTTPS_REQUEST_INTERVAL_SEC
	int "HTTPS request interval in seconds"
	help
	  The interval between periodic HTTPS requests.

config APP_HTTPS_CLIENT_STACK_SIZE
	int "HTTPS client thread stack size"
	help
	  Stack size for the HTTPS client thread.

config APP_HTTPS_CLIENT_THREAD_PRIORITY
	int "HTTPS client thread priority"
	help
	  Priority of the HTTPS client thread.

module = APP_HTTPS_CLIENT
module-str = app_https_client
source "subsys/logging/Kconfig.template.log_config"

endif # APP_HTTPS_CLIENT_MODULE
```

## src/modules/app_https_client/Kconfig.defaults
```kconfig
#
# Copyright (c) 2026 Nordic Semiconductor ASA
#
# SPDX-License-Identifier: LicenseRef-Nordic-5-Clause
#
# Default values for app_https_client module symbols.
# Override in prj.conf as needed.
#

config APP_HTTPS_CLIENT_MODULE
	default n

config APP_HTTPS_HOSTNAME
	default "example.com"

config APP_HTTPS_REQUEST_INTERVAL_SEC
	default 300

# HWM 2396 B (TLS/HTTPS) × 1.5 = 3594 → 4096
config APP_HTTPS_CLIENT_STACK_SIZE
	default 4096

config APP_HTTPS_CLIENT_THREAD_PRIORITY
	default 5
```

## src/modules/app_memfault/Kconfig.memfault
```kconfig
#
# Copyright (c) 2026 Nordic Semiconductor ASA
#
# SPDX-License-Identifier: LicenseRef-Nordic-5-Clause
#

config MEMFAULT_MODULE
	bool "Memfault module group"
	depends on MEMFAULT
	default y
	help
	  Memfault core, metrics, OTA triggers, and optional nRF70 CDR.

if MEMFAULT_MODULE

module = MEMFAULT_MODULE
module-str = memfault_module
source "subsys/logging/Kconfig.template.log_config"

config NRF70_FW_STATS_CDR_ENABLED
	bool "Enable nRF70 firmware statistics CDR upload to Memfault"
	depends on MEMFAULT_CDR_ENABLE
	depends on WIFI_NRF70
	default n
	help
	  Collect and upload nRF70 WiFi firmware statistics (PHY, LMAC, UMAC)
	  as Custom Data Recording. Trigger: Button 1 short press.
	  CDR uploads are limited to 1 per device per 24 hours.

config MEMFAULT_UPLOAD_THREAD_STACK_SIZE
	int "Stack size for the Memfault on-connect upload thread (bytes)"
	default 6144
	help
	  Stack size for the thread that performs an immediate Memfault data
	  upload on WiFi connect.  The thread calls getaddrinfo() (DNS) and
	  memfault_zephyr_port_post_data() (TLS + HTTPS), both of which need
	  several kilobytes of stack.  6144 bytes is the recommended minimum
	  for the nRF7002DK.  Override in prj.conf if needed.

endif # MEMFAULT_MODULE
```

## src/modules/app_mqtt_client/Kconfig.app_mqtt_client
```kconfig
#
# Copyright (c) 2026 Nordic Semiconductor ASA
#
# SPDX-License-Identifier: LicenseRef-Nordic-5-Clause
#

config APP_MQTT_CLIENT_MODULE
	bool "Enable MQTT client with TLS"
	select MQTT_HELPER
	select HW_ID_LIBRARY
	help
	  Enable application MQTT client (TLS, echo test). Uses mqtt_helper library.

if APP_MQTT_CLIENT_MODULE

config APP_MQTT_CLIENT_BROKER_HOSTNAME
	string "MQTT broker hostname"
	help
	  The hostname of the MQTT broker to connect to.

config APP_MQTT_CLIENT_PUBLISH_TOPIC
	string "MQTT publish topic suffix"
	help
	  The topic suffix for publishing messages.

config APP_MQTT_CLIENT_PUBLISH_INTERVAL_SEC
	int "MQTT publish interval in seconds"
	range 1 86400
	help
	  The interval between periodic MQTT message publishes.

config APP_MQTT_CLIENT_RECONNECT_TIMEOUT_SEC
	int "MQTT reconnection timeout in seconds"
	help
	  Time between reconnection attempts to the MQTT broker.

config APP_MQTT_CLIENT_STACK_SIZE
	int "MQTT client thread stack size"
	help
	  Stack size for the MQTT client thread.

config APP_MQTT_CLIENT_THREAD_PRIORITY
	int "MQTT client thread priority"
	help
	  Priority of the MQTT client thread.

config APP_MQTT_CLIENT_ID_BUFFER_SIZE
	int "MQTT client ID buffer size"
	help
	  Size of buffer used to store the MQTT client ID.

module = APP_MQTT_CLIENT
module-str = app_mqtt_client
source "subsys/logging/Kconfig.template.log_config"

endif # APP_MQTT_CLIENT_MODULE
```

## src/modules/app_mqtt_client/Kconfig.defaults
```kconfig
#
# Copyright (c) 2026 Nordic Semiconductor ASA
#
# SPDX-License-Identifier: LicenseRef-Nordic-5-Clause
#
# Default values for app_mqtt_client module symbols.
# Override in prj.conf as needed.
# Note: choice symbols (log levels) cannot be set here; use prj.conf.
#

config APP_MQTT_CLIENT_MODULE
	default n

config APP_MQTT_CLIENT_BROKER_HOSTNAME
	default "test.mosquitto.org"

config APP_MQTT_CLIENT_PUBLISH_TOPIC
	default "count"

config APP_MQTT_CLIENT_PUBLISH_INTERVAL_SEC
	default 300

config APP_MQTT_CLIENT_RECONNECT_TIMEOUT_SEC
	default 60

# 6144: mqtt_helper_init() calls tls_credential_add() (cert parsing via mbedTLS)
# before the semaphore wait — needs more than the library default of 4096.
config APP_MQTT_CLIENT_STACK_SIZE
	default 6144 if APP_MQTT_CLIENT_MODULE

config APP_MQTT_CLIENT_THREAD_PRIORITY
	default 5

config APP_MQTT_CLIENT_ID_BUFFER_SIZE
	default 50

# ---------------------------------------------------------------------------
# Hardware ID source (MAC address used as MQTT client ID)
# ---------------------------------------------------------------------------
# HW_ID_LIBRARY_SOURCE_NET_MAC is a choice symbol - set in prj.conf.

# ---------------------------------------------------------------------------
# MQTT helper library settings
# ---------------------------------------------------------------------------
config MQTT_CLEAN_SESSION
	default y if APP_MQTT_CLIENT_MODULE

config MQTT_LIB_TLS
	default y if APP_MQTT_CLIENT_MODULE

config MQTT_HELPER_PORT
	default 8883 if APP_MQTT_CLIENT_MODULE

# Keepalive reduced to 15 s for networks with aggressive NAT timeouts.
config MQTT_KEEPALIVE
	default 15 if APP_MQTT_CLIENT_MODULE

# Note: MQTT_HELPER_SEC_TAG is project-specific; set in prj.conf.

config MQTT_HELPER_PROVISION_CERTIFICATES
	default y if APP_MQTT_CLIENT_MODULE

config MQTT_HELPER_CERTIFICATES_FOLDER
	default "src/modules/app_mqtt_client/cert" if APP_MQTT_CLIENT_MODULE
```

## src/modules/button/Kconfig.button
```kconfig
#
# Copyright (c) 2026 Nordic Semiconductor ASA
#
# SPDX-License-Identifier: LicenseRef-Nordic-5-Clause
#

config BUTTON_MODULE
	bool "Button Module"
	default y
	help
	  Enable button module with SMF state machine (short/long press).
	  Publishes BUTTON_CHAN for Memfault heartbeat, OTA, and demo faults.

if BUTTON_MODULE

module = BUTTON_MODULE
module-str = button_module
source "subsys/logging/Kconfig.template.log_config"

config BUTTON_LONG_PRESS_MS
	int "Long press threshold in milliseconds"
	default 3000
	help
	  Button press duration (ms) to trigger long-press action (e.g. crash demo).

endif # BUTTON_MODULE
```

## src/modules/heap_monitor/Kconfig.defaults
```kconfig
#
# Copyright (c) 2026 Nordic Semiconductor ASA
#
# SPDX-License-Identifier: LicenseRef-Nordic-5-Clause
#
# Default values for heap_monitor module symbols.
# Override in prj.conf as needed.
#

config HEAPS_MONITOR
	default n

config HEAPS_MONITOR_WARN_PCT
	default 88 if HEAPS_MONITOR

config HEAPS_MONITOR_STEP_BYTES
	default 512 if HEAPS_MONITOR

config HEAPS_MONITOR_PERIODIC_INTERVAL_SEC
	default 30 if HEAPS_MONITOR
```

## src/modules/heap_monitor/Kconfig.heap_monitor
```kconfig
#
# Copyright (c) 2026 Nordic Semiconductor ASA
#
# SPDX-License-Identifier: LicenseRef-Nordic-5-Clause
#

config HEAPS_MONITOR
	bool "Enable heap monitor module"
	depends on (HEAP_MEM_POOL_SIZE > 0) || MBEDTLS_ENABLE_HEAP
	select SYS_HEAP_LISTENER if HEAP_MEM_POOL_SIZE > 0
	select SYS_HEAP_RUNTIME_STATS if HEAP_MEM_POOL_SIZE > 0
	select MBEDTLS_MEMORY_DEBUG if MBEDTLS_ENABLE_HEAP
	help
	  Enable a reusable heap monitor module under src/modules/heap_monitor.
	  The module automatically monitors the heaps available in the build:
	  system heap when CONFIG_HEAP_MEM_POOL_SIZE > 0 and mbedTLS heap when
	  CONFIG_MBEDTLS_ENABLE_HEAP=y. If the Memfault module is enabled, the
	  monitor also updates heap metrics for Memfault heartbeats.

if HEAPS_MONITOR

module = HEAPS_MONITOR
module-str = heaps_monitor
source "subsys/logging/Kconfig.template.log_config"

config HEAPS_MONITOR_WARN_PCT
	int "Heap warning threshold percent"
	range 50 100
	help
	  Emit warning-level logs when the used percentage of a periodic sample or
	  peak sample reaches this threshold.

config HEAPS_MONITOR_STEP_BYTES
	int "Peak report step size in bytes"
	range 128 8192
	help
	  Log a new system-heap peak when the all-time high-water mark increases by
	  at least this amount.

config HEAPS_MONITOR_PERIODIC_INTERVAL_SEC
	int "Periodic heap snapshot interval in seconds"
	range 1 86400
	help
	  Interval between standardized heap snapshot logs.

endif # HEAPS_MONITOR
```

## src/modules/memfault/Kconfig.memfault
```kconfig
#
# Copyright (c) 2026 Nordic Semiconductor ASA
#
# SPDX-License-Identifier: LicenseRef-Nordic-5-Clause
#

config MEMFAULT_MODULE
	bool "Memfault module group"
	depends on MEMFAULT
	default y
	help
	  Memfault core, metrics, OTA triggers, and optional nRF70 CDR.

if MEMFAULT_MODULE

module = MEMFAULT_MODULE
module-str = memfault_module
source "subsys/logging/Kconfig.template.log_config"

config NRF70_FW_STATS_CDR_ENABLED
	bool "Enable nRF70 firmware statistics CDR upload to Memfault"
	depends on MEMFAULT_CDR_ENABLE
	depends on WIFI_NRF70
	default n
	help
	  Collect and upload nRF70 WiFi firmware statistics (PHY, LMAC, UMAC)
	  as Custom Data Recording. Trigger: Button 1 short press.
	  CDR uploads are limited to 1 per device per 24 hours.

endif # MEMFAULT_MODULE
```

## src/modules/ux/Kconfig
```kconfig
# Copyright (c) 2026 Nordic Semiconductor ASA
# SPDX-License-Identifier: LicenseRef-Nordic-5-Clause

config APP_UX_MODULE
	bool "Application UX module (LED Wi-Fi state feedback)"
	depends on ZEGO_LED
	default n
	help
	  Drives LED 0 based on Wi-Fi connectivity state published on
	  APP_WIFI_STATE_CHAN:
	    CONNECTING  →  ROTATE (boot animation)
	    CONNECTED   →  Solid ON
	    ERROR       →  Fast BLINK (100 ms half-period)

	  This is a LED-only module.  Button gestures are handled separately
	  by the app_memfault module (BUTTON_CHAN subscriber).

if APP_UX_MODULE

config APP_UX_INIT_PRIORITY
	int "UX module SYS_INIT priority"
	default 95
	help
	  Must be higher (later) than ZEGO_LED_INIT_PRIORITY (91) so the LED
	  module is fully initialised before the UX module starts ROTATE.

endif # APP_UX_MODULE
```

## src/modules/wifi_prov_over_ble/Kconfig.defaults
```kconfig
#
# Copyright (c) 2026 Nordic Semiconductor ASA
#
# SPDX-License-Identifier: LicenseRef-Nordic-5-Clause
#
# Default values for wifi_prov_over_ble module symbols.
# Override in prj.conf as needed.
# Note: choice symbols (log levels) cannot be set here; use prj.conf.
#

config WIFI_STA_PROV_OVER_BLE_ENABLED
	default n

# ---------------------------------------------------------------------------
# Bluetooth LE stack tuning for WiFi provisioning over BLE
# ---------------------------------------------------------------------------

# Do not store BLE bonds; provisioning app re-pairs each session.
config BT_BONDABLE
	default n if WIFI_STA_PROV_OVER_BLE_ENABLED

config BT_DEVICE_NAME_DYNAMIC
	default y if WIFI_STA_PROV_OVER_BLE_ENABLED

# BT buffer sizes tuned for the nRF Wi-Fi Provisioner MTU (147 bytes L2CAP).
config BT_BUF_ACL_RX_SIZE
	default 151 if WIFI_STA_PROV_OVER_BLE_ENABLED

config BT_L2CAP_TX_MTU
	default 147 if WIFI_STA_PROV_OVER_BLE_ENABLED

config BT_BUF_ACL_TX_SIZE
	default 151 if WIFI_STA_PROV_OVER_BLE_ENABLED

# CRITICAL: BLE and WiFi share the same BT RX workqueue during provisioning.
# 22000 bytes required to handle concurrent WiFi scan + BLE traffic.
config BT_RX_STACK_SIZE
	default 22000 if WIFI_STA_PROV_OVER_BLE_ENABLED

# 75 units (750 ms) — avoids supervision timeout during WiFi scan delays.
config BT_PERIPHERAL_PREF_TIMEOUT
	default 75 if WIFI_STA_PROV_OVER_BLE_ENABLED
```

## src/modules/wifi_prov_over_ble/Kconfig.wifi_prov_over_ble
```kconfig
#
# Copyright (c) 2026 Nordic Semiconductor ASA
#
# SPDX-License-Identifier: LicenseRef-Nordic-5-Clause
#

config WIFI_STA_PROV_OVER_BLE_ENABLED
	bool "Enable WiFi provisioning over BLE"
	select BT
	select BT_PERIPHERAL
	select BT_SMP
	select BT_WIFI_PROV
	select WIFI_PROV_CORE
	select NANOPB
	default n
	help
	  Enable Bluetooth LE based WiFi provisioning.
	  WiFi credentials can be configured via nRF Wi-Fi Provisioner app.

if WIFI_STA_PROV_OVER_BLE_ENABLED

module = WIFI_PROV_OVER_BLE
module-str = wifi_prov_over_ble
source "subsys/logging/Kconfig.template.log_config"

endif # WIFI_STA_PROV_OVER_BLE_ENABLED
```

## sysbuild/hci_ipc/boards/nrf7002dk_nrf5340_cpunet.conf
```kconfig
#
# Copyright (c) 2026 Nordic Semiconductor ASA
#
# SPDX-License-Identifier: LicenseRef-Nordic-5-Clause
#
# hci_ipc network-core overrides for nRF7002DK (nRF5340 CPUNET).
# Wi-Fi provisioning over BLE uses 1M PHY only; 2M PHY is never negotiated
# and can be removed to save controller flash and RAM.
#
CONFIG_BT_CTLR_PHY_2M=n
```

## sysbuild/mcuboot/boards/nrf54lm20dk_nrf54lm20a_cpuapp.conf
```kconfig
#
# Copyright (c) 2026 Nordic Semiconductor ASA
#
# SPDX-License-Identifier: LicenseRef-Nordic-5-Clause
#

CONFIG_HW_STACK_PROTECTION=n
CONFIG_BOOT_WATCHDOG_FEED=n

# SPI NOR driver needed to access the secondary slot on MX25R6435F (spi00).
CONFIG_GPIO=y
CONFIG_SPI=y
CONFIG_SPI_NOR=y
CONFIG_SPI_NOR_SFDP_DEVICETREE=y
CONFIG_SPI_NOR_FLASH_LAYOUT_PAGE_SIZE=4096

# The default nRF54LM20 image slots are larger than the MCUboot default sector cap.
CONFIG_BOOT_MAX_IMG_SECTORS=512

# Avoid SYSCOUNTER drift across software resets in MCUboot on nRF54L.
CONFIG_TICKLESS_KERNEL=y
```

## sysbuild/mcuboot/boards/nrf7002dk_nrf5340_cpuapp.conf
```kconfig
#
# Copyright (c) 2023 Nordic Semiconductor ASA
#
# SPDX-License-Identifier: LicenseRef-Nordic-5-Clause
#

# nRF7002DK uses SPI NOR external flash
CONFIG_GPIO=y
CONFIG_SPI=y
CONFIG_SPI_NOR=y
CONFIG_SPI_NOR_SFDP_DEVICETREE=y
CONFIG_SPI_NOR_FLASH_LAYOUT_PAGE_SIZE=4096

CONFIG_PM_OVERRIDE_EXTERNAL_DRIVER_CHECK=y

# ============================================================================
# Silence the v3.3.0 Kconfig warning:
#   "MBEDTLS_PSA_CRYPTO_EXTERNAL_RNG_ALLOW_NON_CSPRNG was assigned the value
#    'y' but got the value 'n'"
# The nrf7002dk_nrf5340_cpuapp_defconfig sets this symbol to 'y'.
# NRF_SECURITY selects DISABLE_MBEDTLS_BUILTIN and sets
# MBEDTLS_CFG_FILE="nrf-config.h", making the Kconfig.mbedtls menu
# (depends on MBEDTLS_BUILTIN && MBEDTLS_CFG_FILE="config-mbedtls.h")
# invisible.  The dependency is therefore unmet.  Explicitly clearing the
# symbol here overrides the defconfig assignment so the assigned value ('n')
# matches the evaluated value ('n').
#
# A related warning ("The choice symbol MBEDTLS_PSA_CRYPTO_EXTERNAL_RNG was
# selected (set =y) but no symbol ended up as the choice selection") also
# originates from the board defconfig and cannot be silenced at the app
# level: kconfiglib does not honour "# CONFIG_CHOICE_SYMBOL is not set" for
# choice symbols, so the defconfig's choice assignment persists.  This is a
# known upstream issue (NRF_SECURITY overrides the choice via CMake, but the
# Kconfig layer is left inconsistent).  The warning is harmless; nrf_security
# always provides its own RNG implementation regardless of this choice.
# ============================================================================
# CONFIG_MBEDTLS_PSA_CRYPTO_EXTERNAL_RNG_ALLOW_NON_CSPRNG is not set
```
