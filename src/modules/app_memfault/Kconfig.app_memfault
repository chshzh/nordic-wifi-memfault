## src/modules/app_memfault/Kconfig.app_memfault
```kconfig
#
# Copyright (c) 2026 Nordic Semiconductor ASA
#
# SPDX-License-Identifier: LicenseRef-Nordic-5-Clause
#

config APP_MEMFAULT_MODULE
	bool "Memfault module group"
	select MEMFAULT
	help
	  Memfault core, metrics, OTA triggers, and optional nRF70 CDR.

if APP_MEMFAULT_MODULE

module = APP_MEMFAULT_MODULE
module-str = app_memfault_module
source "subsys/logging/Kconfig.template.log_config"

config NRF70_FW_STATS_CDR_ENABLED
	bool "Enable nRF70 firmware statistics CDR upload to Memfault"
	depends on MEMFAULT_CDR_ENABLE
	depends on WIFI_NRF700X
	help
	  Collect and upload nRF70 WiFi firmware statistics (PHY, LMAC, UMAC)
	  as Custom Data Recording. Trigger: Button 1 short press, or every
	  Memfault metrics heartbeat (same cadence as metrics/log collection --
	  see memfault_metrics_heartbeat_collect_data() in memfault_core.c).
	  CDR uploads are limited to 1 per device per 24 hours.

config MEMFAULT_UPLOAD_THREAD_STACK_SIZE
	int "Stack size for the Memfault on-connect upload thread (bytes)"
	help
	  Stack size for the thread that performs an immediate Memfault data
	  upload on WiFi connect.  The thread calls getaddrinfo() (DNS) and
	  memfault_zephyr_port_post_data() (TLS + HTTPS), both of which need
	  several kilobytes of stack.  6144 bytes is the recommended minimum
	  for the nRF7002DK.  Override in prj.conf if needed.

config MEMFAULT_OTA_CHECK_INTERVAL_MIN
	int "Periodic OTA check interval in minutes"
	range 1 1440
	help
	  How often the OTA trigger thread checks Memfault cloud for a new
	  firmware release when no manual trigger (button or connect event)
	  has fired.  Default is 60 minutes.

config MEMFAULT_OTA_CONNECT_DELAY_SEC
	int "Delay before OTA check after network connect or button press (seconds)"
	range 0 300
	help
	  After a network-connect or button-press event signals the OTA thread,
	  the thread sleeps this many seconds before calling memfault_fota_start().
	  This gives the DNS resolver time to settle after a fresh connection.
	  Default is 60 seconds.

config MEMFAULT_OTA_THREAD_STACK_SIZE
	int "Stack size for the Memfault OTA trigger thread (bytes)"
	help
	  Stack size for the thread that calls memfault_fota_start().
	  4096 bytes is sufficient as the Memfault NCS port spawns its own
	  HTTPS transfer internally.  Override in prj.conf if needed.

config APP_MEMFAULT_HEARTBEAT_FORCE_INTERVAL_SEC
	int "Force an immediate Memfault heartbeat + log collection + upload every N seconds while connected (0 = disabled)"
	range 0 3600
	help
	  The Memfault SDK version bundled with NCS v2.6.4 has a fixed 3600 s
	  metrics heartbeat interval (no MEMFAULT_METRICS_HEARTBEAT_INTERVAL_SECS
	  Kconfig to shorten it), and log entries are never uploaded at all
	  unless memfault_log_trigger_collection() is called (normally only
	  done after a disconnect/reconnect restore). For active testing/
	  debugging where you want metrics AND logs to show up on the Memfault
	  dashboard faster than once an hour / without a disconnect, set this to
	  periodically call memfault_metrics_heartbeat_debug_trigger() +
	  memfault_log_trigger_collection() and post the result while WiFi is
	  connected. Leave at 0 (default) for production builds: forcing
	  frequent uploads increases Memfault ingestion volume and HTTPS/radio
	  activity.

config APP_MEMFAULT_LOG_STATE_RESTORE
	bool "Persist disconnect-time Memfault log entries; restore and upload on next WiFi connect"
	depends on FLASH_MAP
	help
	  On connectivity loss, drains unread entries from the live Memfault log
	  ring buffer (via memfault_log_read()) and serializes them to a
	  dedicated partition on the external SPI/QSPI NOR flash
	  ("mflt_log_state_partition", MX25R64).  On the next WiFi reconnect,
	  the entries are replayed back into the ring buffer (via
	  memfault_log_save_preformatted()) before upload, and
	  memfault_log_trigger_collection() marks them for upload.  The
	  partition is erased after the restore.
	  Note: the Memfault SDK version bundled with NCS v2.6.4 has no raw
	  ring-buffer save/restore API (memfault_log_get_state() /
	  memfault_log_restore_state()), so this drain-and-replay approach is
	  used instead of a raw memory copy. Replayed entries carry the
	  restore-time timestamp, not the original disconnect-time timestamp.

config APP_MEMFAULT_CDR_STATE_RESTORE
	bool "Persist disconnect-time nRF70 CDR (WiFi stats) to flash; restore and upload on reconnect"
	depends on FLASH_MAP
	depends on NRF70_FW_STATS_CDR_ENABLED
	help
	  When the log-persist work fires 10 s after connectivity loss, collects
	  fresh nRF70 firmware statistics (PHY/LMAC/UMAC) and writes the raw CDR
	  blob to a dedicated partition on the external SPI/QSPI NOR flash
	  ("mflt_cdr_state_partition", MX25R64).  On the next WiFi reconnect the
	  blob is restored into the CDR source buffer and uploaded to Memfault
	  cloud.  The partition is erased after restore.

endif # APP_MEMFAULT_MODULE
```

## src/modules/network/Kconfig
```kconfig
#
# Copyright (c) 2025 Nordic Semiconductor ASA
#
# SPDX-License-Identifier: LicenseRef-Nordic-5-Clause
#

config WIFI_MODULE
	bool "WiFi and Network Event Management Module"
	default y
	help
	  Enable WiFi and network event management module with L2/L3 event handling.
	  Provides semaphore-based synchronization for network readiness.

if WIFI_MODULE

config WIFI_MODULE_INIT_PRIORITY
	int "WiFi module initialization priority"
	default 90
	help
	  Set the initialization priority for the WiFi module.
	  Must be high enough to ensure network stack is ready.

config WIFI_MODULE_STA_DHCP_TIMEOUT_SEC
	int "STA: DHCP-bound watchdog timeout (s, 0 = disabled)"
	default 30
	range 0 300
	help
	  L3 connectivity watchdog for STA mode. A successful Wi-Fi association
	  (NET_EVENT_WIFI_CONNECT_RESULT) only means the link is up at L2 -- it
	  does NOT mean an IP was obtained. If DHCP never binds
	  (NET_EVENT_IPV4_DHCP_BOUND) within this many seconds of association,
	  or a bound lease is later lost while the link stays associated, the
	  device is stuck "associated but no IP" with no usable connectivity
	  and no event that would otherwise trigger a reconnect.

	  When this timer expires the module issues NET_REQUEST_WIFI_DISCONNECT,
	  which produces a DISCONNECT_RESULT and re-arms the normal reconnect
	  path (wifi_prov_over_ble), breaking the device out of the
	  half-connected state instead of waiting for a manual reset.

	  Set to 0 to disable the watchdog.

module = WIFI_MODULE
module-str = wifi_module
source "subsys/logging/Kconfig.template.log_config"

endif # WIFI_MODULE
```

## src/modules/ntp/Kconfig.defaults
```kconfig
#
# Copyright (c) 2026 Nordic Semiconductor ASA
#
# SPDX-License-Identifier: LicenseRef-Nordic-5-Clause
#
# Default values for ntp module symbols.
# Override in prj.conf as needed.
#

config NTP_MODULE_ENABLED
	default n

config NTP_MODULE_SERVER
	default "pool.ntp.org" if NTP_MODULE_ENABLED

config NTP_MODULE_TIMEOUT_MS
	default 5000 if NTP_MODULE_ENABLED

config NTP_MODULE_RETRY_INTERVAL_SEC
	default 30 if NTP_MODULE_ENABLED

config NTP_MODULE_RESYNC_INTERVAL_SEC
	default 10800 if NTP_MODULE_ENABLED
```

## src/modules/ntp/Kconfig.ntp
```kconfig
#
# Copyright (c) 2026 Nordic Semiconductor ASA
#
# SPDX-License-Identifier: LicenseRef-Nordic-5-Clause
#

config NTP_MODULE_ENABLED
	bool "Enable NTP time synchronization module"
	select SNTP
	depends on ZBUS && NETWORKING && POSIX_CLOCK
	help
	  Queries an SNTP server and sets CLOCK_REALTIME once Wi-Fi
	  connectivity is established (NETWORK_READY on NETWORK_CHAN). When
	  CONFIG_LOG_TIMESTAMP_USE_REALTIME=y is also set, Zephyr log output
	  shows real-world wall-clock timestamps, and application code that
	  reads CLOCK_REALTIME (e.g. Memfault event/log timestamps, including
	  the FR-102 disconnect-time log-state restore) gets real UTC time
	  instead of device uptime.

	  Ported from zego/bricks/ntp.

if NTP_MODULE_ENABLED

module = NTP_MODULE
module-str = ntp_module
source "subsys/logging/Kconfig.template.log_config"

config NTP_MODULE_SERVER
	string "SNTP server hostname"
	help
	  Hostname of the SNTP server used for time synchronization.

config NTP_MODULE_TIMEOUT_MS
	int "SNTP query timeout (ms)"
	range 1000 30000
	help
	  Maximum time to wait for an SNTP response, in milliseconds.

config NTP_MODULE_RETRY_INTERVAL_SEC
	int "Retry interval on failure (s)"
	range 5 3600
	help
	  How long to wait before retrying a failed SNTP query.

config NTP_MODULE_RESYNC_INTERVAL_SEC
	int "Periodic re-sync interval after a successful sync (s)"
	range 0 86400
	help
	  How often to re-sync after a successful query to compensate for
	  crystal oscillator drift. Set to 0 to disable periodic re-sync
	  (sync once per connection only).

endif # NTP_MODULE_ENABLED
```
