/*
 * Copyright (c) 2023 Nordic Semiconductor ASA
 *
 * SPDX-License-Identifier: LicenseRef-Nordic-5-Clause
 */

#include "../../../boards/nrf7002dk_nrf5340_cpuapp.overlay"

/ {
	chosen {
		/delete-property/ zephyr,ipc_shm;
		zephyr,code-partition = &boot_partition;
	};
};
